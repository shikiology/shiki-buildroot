## external/Config.in
```kconfig
source "$BR2_EXTERNAL_SHIKI_PATH/libsixel/Config.in"
source "$BR2_EXTERNAL_SHIKI_PATH/python-trzsz/Config.in"
source "$BR2_EXTERNAL_SHIKI_PATH/python-trzsz-libs/Config.in"
source "$BR2_EXTERNAL_SHIKI_PATH/python-trzsz-svr/Config.in"
source "$BR2_EXTERNAL_SHIKI_PATH/r8125/Config.in"
source "$BR2_EXTERNAL_SHIKI_PATH/r8126/Config.in"
source "$BR2_EXTERNAL_SHIKI_PATH/r8168/Config.in"
source "$BR2_EXTERNAL_SHIKI_PATH/r8169/Config.in"
```

## external/python-trzsz-svr/Config.in
```kconfig
config BR2_PACKAGE_PYTHON_TRZSZ_SVR
	bool "python-trzsz-svr"
	select BR2_PACKAGE_PYTHON3_ZLIB # runtime
	help
	  trzsz ( trz / tsz ) is a simple file transfer tools, file
	   similar to lrzsz ( rz / sz ), and compatible with tmux.

	  https://pypi.org/project/trzsz/
```

## external/python-trzsz/Config.in
```kconfig
config BR2_PACKAGE_PYTHON_TRZSZ
	bool "python-trzsz"
	select BR2_PACKAGE_PYTHON3_ZLIB # runtime
	select BR2_PACKAGE_PYTHON_TRZSZ_LIBS
	select BR2_PACKAGE_PYTHON_TRZSZ_SVR
	help
	  trzsz ( trz / tsz ) is a simple file transfer tools, file
	   similar to lrzsz ( rz / sz ), and compatible with tmux.

	  https://pypi.org/project/trzsz/
```

## external/r8126/Config.in
```kconfig
config BR2_PACKAGE_R8126
	bool "r8126"
	depends on BR2_LINUX_KERNEL
	help
	  A standalone driver for the RTL8126 Ethernet adapter.

	  https://github.com/shikiology/r8126

comment "r8126 needs a Linux kernel to be built"
	depends on !BR2_LINUX_KERNEL
```
